/* ASAP区域起始地址 */
PROVIDE(_asap_metadata_start = 0x4400);
PROVIDE(_asap_slots_start = 0x4500);
PROVIDE(_asap_commits_start = 0x6500);

/* ASAP槽位符号 */
PROVIDE(__RS_S0_0120 = 16384);
PROVIDE(__RS_S1_0120 = 16386);
PROVIDE(__RS_S0_015c = 16388);
PROVIDE(__RS_S1_015c = 16390);
PROVIDE(__RS_S0_0161 = 16392);
PROVIDE(__RS_S1_0161 = 16394);
PROVIDE(__RS_S0_0162 = 16396);
PROVIDE(__RS_S1_0162 = 16398);
PROVIDE(__RS_S0_0164 = 16400);
PROVIDE(__RS_S1_0164 = 16402);
PROVIDE(__RS_S0_0166 = 16404);
PROVIDE(__RS_S1_0166 = 16406);
PROVIDE(__RS_S0_020b = 16408);
PROVIDE(__RS_S1_020b = 16410);
PROVIDE(__RS_S0_020d = 16412);
PROVIDE(__RS_S1_020d = 16414);
PROVIDE(__RS_S0_03c0 = 16416);
PROVIDE(__RS_S1_03c0 = 16418);
PROVIDE(__RS_S0_03c4 = 16420);
PROVIDE(__RS_S1_03c4 = 16422);
PROVIDE(__RS_S0_03d4 = 16424);
PROVIDE(__RS_S1_03d4 = 16426);
PROVIDE(__RS_S0_05c0 = 16428);
PROVIDE(__RS_S1_05c0 = 16430);
PROVIDE(__RS_S0_05c6 = 16432);
PROVIDE(__RS_S1_05c6 = 16434);
PROVIDE(__RS_S0_05c8 = 16436);
PROVIDE(__RS_S1_05c8 = 16438);
PROVIDE(__RS_S0_05ce = 16440);
PROVIDE(__RS_S1_05ce = 16442);
PROVIDE(__RS_S0_235f = 16444);
PROVIDE(__RS_S1_235f = 16446);
PROVIDE(__RS_S0_2360 = 16448);
PROVIDE(__RS_S1_2360 = 16450);
PROVIDE(__RS_S0_2361 = 16452);
PROVIDE(__RS_S1_2361 = 16454);
PROVIDE(__RS_S0_2362 = 16456);
PROVIDE(__RS_S1_2362 = 16458);
PROVIDE(__RS_S0_r1_10 = 16460);
PROVIDE(__RS_S1_r1_10 = 16462);
PROVIDE(__RS_S0_r1_12 = 16464);
PROVIDE(__RS_S1_r1_12 = 16466);
PROVIDE(__RS_S0_r1_129 = 16468);
PROVIDE(__RS_S1_r1_129 = 16470);
PROVIDE(__RS_S0_r1_130 = 16472);
PROVIDE(__RS_S1_r1_130 = 16474);
PROVIDE(__RS_S0_r1_14 = 16476);
PROVIDE(__RS_S1_r1_14 = 16478);
PROVIDE(__RS_S0_r1_16 = 16480);
PROVIDE(__RS_S1_r1_16 = 16482);
PROVIDE(__RS_S0_r1_18 = 16484);
PROVIDE(__RS_S1_r1_18 = 16486);
PROVIDE(__RS_S0_r1_2 = 16488);
PROVIDE(__RS_S1_r1_2 = 16490);
PROVIDE(__RS_S0_r1_20 = 16492);
PROVIDE(__RS_S1_r1_20 = 16494);
PROVIDE(__RS_S0_r1_22 = 16496);
PROVIDE(__RS_S1_r1_22 = 16498);
PROVIDE(__RS_S0_r1_24 = 16500);
PROVIDE(__RS_S1_r1_24 = 16502);
PROVIDE(__RS_S0_r1_4 = 16504);
PROVIDE(__RS_S1_r1_4 = 16506);
PROVIDE(__RS_S0_r1_5 = 16508);
PROVIDE(__RS_S1_r1_5 = 16510);
PROVIDE(__RS_S0_r1_6 = 16512);
PROVIDE(__RS_S1_r1_6 = 16514);
PROVIDE(__RS_S0_r1_7 = 16516);
PROVIDE(__RS_S1_r1_7 = 16518);
PROVIDE(__RS_S0_r1_8 = 16520);
PROVIDE(__RS_S1_r1_8 = 16522);
PROVIDE(__RS_S0_r1_9 = 16524);
PROVIDE(__RS_S1_r1_9 = 16526);

/* ASAP提交位符号 */
PROVIDE(__RS_COMMIT_W1 = 16528);
PROVIDE(__RS_COMMIT_W2 = 16529);
PROVIDE(__RS_COMMIT_W3 = 16530);
PROVIDE(__RS_COMMIT_W4 = 16531);
PROVIDE(__RS_COMMIT_W5 = 16532);
PROVIDE(__RS_COMMIT_W6 = 16533);
PROVIDE(__RS_COMMIT_W7 = 16534);
PROVIDE(__RS_COMMIT_W8 = 16535);
PROVIDE(__RS_COMMIT_W9 = 16536);
PROVIDE(__RS_COMMIT_W10 = 16537);
PROVIDE(__RS_COMMIT_W11 = 16538);
PROVIDE(__RS_COMMIT_W12 = 16539);
PROVIDE(__RS_COMMIT_W13 = 16540);
PROVIDE(__RS_COMMIT_W14 = 16541);
PROVIDE(__RS_COMMIT_W15 = 16542);
PROVIDE(__RS_COMMIT_W16 = 16543);
PROVIDE(__RS_COMMIT_W17 = 16544);
PROVIDE(__RS_COMMIT_W18 = 16545);
PROVIDE(__RS_COMMIT_W19 = 16546);
PROVIDE(__RS_COMMIT_W20 = 16547);
PROVIDE(__RS_COMMIT_W21 = 16548);
PROVIDE(__RS_COMMIT_W22 = 16549);
PROVIDE(__RS_COMMIT_W23 = 16550);
PROVIDE(__RS_COMMIT_W24 = 16551);
PROVIDE(__RS_COMMIT_W25 = 16552);
PROVIDE(__RS_COMMIT_W26 = 16553);
PROVIDE(__RS_COMMIT_W27 = 16554);
PROVIDE(__RS_COMMIT_W28 = 16555);
PROVIDE(__RS_COMMIT_W29 = 16556);
PROVIDE(__RS_COMMIT_W30 = 16557);
PROVIDE(__RS_COMMIT_W31 = 16558);
PROVIDE(__RS_COMMIT_W32 = 16559);
PROVIDE(__RS_COMMIT_W33 = 16560);
PROVIDE(__RS_COMMIT_W34 = 16561);
PROVIDE(__RS_COMMIT_W35 = 16562);
PROVIDE(__RS_COMMIT_W36 = 16563);
PROVIDE(__RS_COMMIT_W37 = 16564);
PROVIDE(__RS_COMMIT_W38 = 16565);
PROVIDE(__RS_COMMIT_W39 = 16566);
PROVIDE(__RS_COMMIT_W40 = 16567);
PROVIDE(__RS_COMMIT_W41 = 16568);
PROVIDE(__RS_COMMIT_W42 = 16569);
PROVIDE(__RS_COMMIT_W43 = 16570);
PROVIDE(__RS_COMMIT_W44 = 16571);
PROVIDE(__RS_COMMIT_W45 = 16572);
PROVIDE(__RS_COMMIT_W46 = 16573);
PROVIDE(__RS_COMMIT_W47 = 16574);
PROVIDE(__RS_COMMIT_W48 = 16575);
PROVIDE(__RS_COMMIT_W49 = 16576);
PROVIDE(__RS_COMMIT_W50 = 16577);
PROVIDE(__RS_COMMIT_W51 = 16578);
PROVIDE(__RS_COMMIT_W52 = 16579);
PROVIDE(__RS_COMMIT_W53 = 16580);
PROVIDE(__RS_COMMIT_W54 = 16581);
PROVIDE(__RS_COMMIT_W55 = 16582);
PROVIDE(__RS_COMMIT_W56 = 16583);
PROVIDE(__RS_COMMIT_W57 = 16584);
PROVIDE(__RS_COMMIT_W58 = 16585);
PROVIDE(__RS_COMMIT_W59 = 16586);
PROVIDE(__RS_COMMIT_W60 = 16587);
PROVIDE(__RS_COMMIT_W61 = 16588);
PROVIDE(__RS_COMMIT_W62 = 16589);
PROVIDE(__RS_COMMIT_W63 = 16590);
PROVIDE(__RS_COMMIT_W64 = 16591);
PROVIDE(__RS_COMMIT_W65 = 16592);
PROVIDE(__RS_COMMIT_W66 = 16593);
PROVIDE(__RS_COMMIT_W67 = 16594);
PROVIDE(__RS_COMMIT_W68 = 16595);
PROVIDE(__RS_COMMIT_W69 = 16596);
PROVIDE(__RS_COMMIT_W70 = 16597);
PROVIDE(__RS_COMMIT_W71 = 16598);
PROVIDE(__RS_COMMIT_W72 = 16599);
PROVIDE(__RS_COMMIT_W73 = 16600);
PROVIDE(__RS_COMMIT_W74 = 16601);
PROVIDE(__RS_COMMIT_W75 = 16602);
PROVIDE(__RS_COMMIT_W76 = 16603);
PROVIDE(__RS_COMMIT_W77 = 16604);
PROVIDE(__RS_COMMIT_W78 = 16605);
PROVIDE(__RS_COMMIT_W79 = 16606);
PROVIDE(__RS_COMMIT_W80 = 16607);
PROVIDE(__RS_COMMIT_W81 = 16608);
PROVIDE(__RS_COMMIT_W82 = 16609);
PROVIDE(__RS_COMMIT_W83 = 16610);
PROVIDE(__RS_COMMIT_W84 = 16611);
PROVIDE(__RS_COMMIT_W85 = 16612);
PROVIDE(__RS_COMMIT_W86 = 16613);
PROVIDE(__RS_COMMIT_W87 = 16614);
PROVIDE(__RS_COMMIT_W88 = 16615);
PROVIDE(__RS_COMMIT_W89 = 16616);
PROVIDE(__RS_COMMIT_W90 = 16617);
PROVIDE(__RS_COMMIT_W91 = 16618);
PROVIDE(__RS_COMMIT_W92 = 16619);
PROVIDE(__RS_COMMIT_W93 = 16620);
PROVIDE(__RS_COMMIT_W94 = 16621);
PROVIDE(__RS_COMMIT_W95 = 16622);
PROVIDE(__RS_COMMIT_W96 = 16623);
PROVIDE(__RS_COMMIT_W97 = 16624);
PROVIDE(__RS_COMMIT_W98 = 16625);
PROVIDE(__RS_COMMIT_W99 = 16626);
PROVIDE(__RS_COMMIT_W100 = 16627);
PROVIDE(__RS_COMMIT_W101 = 16628);
PROVIDE(__RS_COMMIT_W102 = 16629);
PROVIDE(__RS_COMMIT_W103 = 16630);
PROVIDE(__RS_COMMIT_W104 = 16631);
PROVIDE(__RS_COMMIT_W105 = 16632);
PROVIDE(__RS_COMMIT_W106 = 16633);
